/*******************************************************************************
 * Copyright (C) 2011-2013 ZheJiang Dahua Technology CO.,LTD.
 *
 * 文件名 : INTF_RF.c
 *
 * 作  者 : 123(ggg)<gg>
 * 版  本 : V1.0.0
 * 日  期 : 2015年4月14日 Create
 *
 * 描  述 : 
 *
 *       1. 硬件说明
 *          无。
 *
 *       2. 程序结构说明。
 *          无。
 *
 *       3. 使用说明。
 *          无。
 *
 *       4. 局限性说明。
 *          无。
 *
 *       5. 其他说明。
 *          无。
 *
 * 修订历史: 
 * 日    期: 
 * 修订版本:
 * 作    者:
 * 修订备注:
 *******************************************************************************/



/* ========================================================================== */
/*                             头文件区                                       */
/* ========================================================================== */
#include "app_config.h"
#include "include.h"
/* ========================================================================== */
/*                           宏和类型定义区                                   */
/* ========================================================================== */


/* ========================================================================== */
/*                          数据结构定义区                                    */
/* ========================================================================== */
/* 步进 */
const DH_U16 const APC_Step_Val[180] =
{
0   ,1   ,1   ,2   ,4   ,6   ,8   ,10  ,13  ,16  ,19  ,22  ,26  ,30  ,35  ,40  ,
45  ,50  ,56  ,62  ,68  ,75  ,81  ,89  ,96  ,104 ,112 ,120 ,128 ,137 ,146 ,156 ,
165 ,175 ,185 ,196 ,206 ,217 ,228 ,240 ,251 ,263 ,275 ,287 ,300 ,313 ,326 ,339 ,
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2047,2047,2048,2048,
};


/* ========================================================================== */
/*                          函数声明区                                        */
/* ========================================================================== */

/*******************************************************************************
 * 函数名  : RF_INTF_Init
 * 描  述  : 射频控制管脚初始化
 * 输  入  : 无
 * 输  出  : 无
 * 返回值  : 无
 *******************************************************************************/
DH_VOID RF_INTF_GPIOInit(DH_VOID)
{
   
}

/*******************************************************************************
 * 函数名  : RF_INTF_DlySMU
 * 描  述  : 延时，暂时无实现
 * 输  入  : 无
 * 输  出  : 无
 * 返回值  : 无
 *******************************************************************************/
DH_VOID RF_INTF_DlySMU(DH_U32 u32Secs, DH_U32 u32Ms, DH_U32 u32Us)
{
    //PIT2_DRV_DlySMU(u32Secs,u32Ms,u32Us);
}

/*******************************************************************************
 * 函数名  : RF_INTF_APCChange
 * 描  述  : APC值切换处理
 * 输  入  : u16Target:目标值，u16Src:源值
 * 输  出  : 无
 * 返回值  : 无
 *******************************************************************************/
DH_VOID  RF_INTF_APCChange(DH_U16 u16Target, DH_U16 u16Src)
{
    DH_U8 i;
    DH_U16 ValueMnt;
	if (u16Target >= u16Src)
	{
		for(i=0;i<180;i++)
		{
			 ValueMnt =(DH_U16)((u16Target*APC_Step_Val[i])>>11);
			 RF_INTF_APCSet(ValueMnt);
			 Delay_us(4);
		}
	}
	else
	{
		for(i=0;i<180;i++)
		{
			 ValueMnt =(DH_U16)((u16Src*APC_Step_Val[179-i])>>11);
			 RF_INTF_APCSet(ValueMnt);
			 Delay_us(4);
		}
	}

}

/***************************************************************************
* 函数名：RF_INTF_SetRx
* 描  述：设置发射
* 输  入：无
* 输  出：无
* 返回值：无
***************************************************************************/
DH_VOID  RF_INTF_SetTx(DH_U32 u32Freq)
{
	RF_VCO_POW_EN;
	IC15E03_INTF_SetTxFreq(u32Freq,0,0);

}

/***************************************************************************
* 函数名：RF_INTF_SetRx
* 描  述：设置接收
* 输  入：无
* 输  出：无
* 返回值：无
***************************************************************************/
DH_VOID  RF_INTF_SetRx(DH_U32 u32Freq)
{
	RF_VCO_POW_EN;
	IC15E03_INTF_SetRxFreq(u32Freq,0,0);
}

/***************************************************************************
* 函数名：RF_INTF_GetRssiLevelStat
* 描  述：获取信号
* 输  入：无
* 输  出：0:无信号，非0有信号
* 返回值：无
***************************************************************************/
DH_U16 RF_INTF_GetSignal(DH_VOID)
{
    //SIGNAL_U str;
    DH_U16 u16Data=0;
  //  if(CHN_BLL_GetAttr()==CHNSTAT_FM)
	{
//		u16Data = ADC_DRV_GetChnValue(CHN_ADC_RSSI);
	}
    return u16Data;
}


/***************************************************************************
* 函数名：RF_INTF_GetRssiLevelStat
* 描  述：获取RSSI门限
* 输  入：无
* 输  出：0:无信号，非0有信号
* 返回值：无
***************************************************************************/
DH_U8 RF_INTF_GetRssiLevelStat(DH_VOID)
{
	DH_U8 i;
	DH_U32 SignalValue=0;
//	return 0;
	for(i=0;i<8;i++)
	{
		SignalValue += RF_INTF_GetSignal();

		Delay_ms(10);
	}

	SignalValue >>= 3;/*除以8，求均值*/
//	printk("SignalValue %d.",SignalValue);
	if(SignalValue < RF_RSSI_LEVEL)
	{
		return 0;
	}
	else
	{
		return 1;
	}
}


/*******************************************************************************
 * 函数名  : RF_INTF_APCSet
 * 描  述  : 设置APC值
 * 输  入  : 无
 * 输  出  : 无
 * 返回值  : 无
 *******************************************************************************/
DH_VOID  RF_INTF_APCSet(DH_U16 u16Val)
{
	APC_INTF_Set(u16Val*100/4096);
}

/*******************************************************************************
 * 函数名  : RF_INTF_TVSet
 * 描  述  : 设置电调值
 * 输  入  : 无
 * 输  出  : 无
 * 返回值  : 无
 *******************************************************************************/
DH_VOID RF_INTF_TVSet(DH_U16 u16Val)
{
 
}

/*******************************************************************************
 * 函数名  : RF_INTF_BIASSet
 * 描  述  : 设置偏置值
 * 输  入  : 无
 * 输  出  : 无
 * 返回值  : 无
 *******************************************************************************/
DH_VOID RF_INTF_BIASSet(DH_U16 u16Val)
{

}


/*******************************************************************************
 * 函数名  : RF_INTF_SetTxAmpbias
 * 描  述  : 发送I,Q路偏置值设置
 * 输  入  : 无
 * 输  出  : 无
 * 返回值  : 无
 *******************************************************************************/
DH_VOID RF_INTF_SetTxAmpbias(DH_U16 Ampbias)
{

}

/*******************************************************************************
 * 函数名  : RF_INTF_SetRxAmpbias
 * 描  述  : 接收I,Q路偏置值设置
 * 输  入  : 无
 * 输  出  : 无
 * 返回值  : 无
 *******************************************************************************/
DH_VOID RF_INTF_SetRxAmpbias(DH_U16 Afc)
{
	
}

/*******************************************************************************
 * 函数名  : RF_INTF_AdjIQAmp
 * 描  述  : 两点模式下调整Mod2+Mod1幅度大小。
 * 输  入  : 无
 * 输  出  : 无
 * 返回值  : 无
 *******************************************************************************/
DH_VOID RF_INTF_AdjIQAmp(DH_U16 mod)
{
	
}

/*******************************************************************************
 * 函数名  : RF_INTF_SetTowPointBias
 * 描  述  : 两点调制偏置调整。
 * 输  入  : 无
 * 输  出  : 无
 * 返回值  : 无
 *******************************************************************************/
DH_VOID RF_INTF_SetTowPointBias(DH_U16 afc)
{
	
}

DH_VOID RF_INTF_SetIQAmpNBias(PLL_INFO_S *str)
{

}
